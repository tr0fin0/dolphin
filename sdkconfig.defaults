## sdkconfig.defaults
```kconfig
CONFIG_ESP_IPC_TASK_STACK_SIZE=8096
CONFIG_LOG_VERSION_2=y
CONFIG_LOG_DEFAULT_LEVEL_INFO=y
CONFIG_LOG_TAG_LEVEL_IMPL_NONE=y
CONFIG_LOG_DYNAMIC_LEVEL_CONTROL=n
CONFIG_LOG_COLORS=y
CONFIG_LOG_COLORS_SUPPORT=y
CONFIG_LOG_TIMESTAMP_SOURCE_SYSTEM=y
CONFIG_ESP_DEFAULT_CPU_FREQ_MHZ_240=y
```
